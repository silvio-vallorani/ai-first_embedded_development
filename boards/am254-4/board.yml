## boards/am254-4/board.yml
```yaml
board: am254-4
description: AM Microsystems EtherCAT load-cell converter, project AM254-4, schematic title block rev 3 (2025-11-28)
mcu: MIMXRT1189CVM8C (U9, LFBGA-289)
cores: [m33, m7]
# Hardware design files are private (hw_reference/, never committed). References below are
# schematic reference designators and MCU balls.
role: >
  Development and sacrificial target for all phase-2 security work (keys, encrypted images,
  fuses, lifecycle changes, authenticated debug). Fuse and lifecycle operations are irreversible.
sdk_base_board: evkmimxrt1180   # SDK board files reused; differences are overridden in boards/am254-4
external_memory:
  qspi_nor:
    part: Winbond W25Q128JWSIQ (U8, SOIC-8); U13 W25Q128JWPIQ (WSON-8) is an unpopulated alternative footprint
    supply: +1.8V (NVCC_GPIO1/NVCC_GPIO2 = +1.8V)
    capacity_bytes: 16777216
    flexspi: FLEXSPI1 port A, 4-bit
    pins:
      FLEXSPI1_A_SCLK: GPIO_B2_08 (A7)
      FLEXSPI1_A_SS0_B: GPIO_B2_09 (D10), 4.7 kOhm pull-up R69 to +1.8V
      FLEXSPI1_A_DATA00: GPIO_B2_10 (A10) -> IO0
      FLEXSPI1_A_DATA01: GPIO_B2_11 (B9) -> IO1
      FLEXSPI1_A_DATA02: GPIO_B2_12 (A8) -> IO2/WP#
      FLEXSPI1_A_DATA03: GPIO_B2_13 (B8) -> IO3/RESET#
      FLEXSPI1_A_DQS: GPIO_B2_07 (A6), test point TP24 only (read-strobe loopback)
    compared_with_evk: same pins and device as the EVK port-A flash; the EVK FCB (133 MHz, loopback from DQS pad, 16 MiB) applies
    verification: schematic_only
  eeprom: 24LC128 (U7, I2C)
leds:
  - {ref: DL1, color: green,  ball: R1, pad: GPIO_EMC_B1_41, gpio: GPIO3_IO09, resistor: R95 3.3k, active: high, use: user LED of the CM7 image}
  - {ref: DL4, color: blue,   ball: N2, pad: GPIO_EMC_B1_40, gpio: GPIO3_IO08, resistor: R79 499,  active: high}
  - {ref: DL5, color: red,    ball: R2, pad: GPIO_EMC_B2_01, gpio: GPIO3_IO11, resistor: R101 499, active: high}
  - {ref: DL2, color: yellow, ball: P1, pad: GPIO_EMC_B1_39, gpio: GPIO3_IO07, resistor: R94 499,  active: high,
     note: symbol pin names inverted (A on GND); PCB pad 1 on GND like the other LEDs, verify fitted polarity}
  - {ref: DL3, color: green, note: power indicator on the U203 output, not driven by the MCU}
debug:
  connector: J1 Tag-Connect (SWD + UART)
  swd: {SWDIO: GPIO_AON_14 (B2), SWCLK: GPIO_AON_13 (A2), SWO: GPIO_AON_11 (A4), reset: GPIO_AON_10 (B5) / POR_B via CR1}
  console: {uart: LPUART1, tx: GPIO_AON_08 (B1), rx: GPIO_AON_09 (A5), baud: 115200}   # same as the EVK
boot:
  boot_mode: BOOT_MODE0..2 on GPIO_AON_00/01/02 through R82..R84, set by DIP switch SW1 (to +3.3V)
  reset: SW2 on POR_B
  test_mode: tied to GND
clocks:
  main_crystal: 24 MHz (Y4)
  rtc_crystal: 32.768 kHz (Y3)
power:
  dcdc: internal DCDC from +3.3V, VDD_SOC through L13
board_specific_pins_not_to_drive:
  - {pad: GPIO_AD_27, net: ADC_MCLK, to: AD7767 U11. The EVK uses this pad for its user LED}
notes:
  - Bring-up of this board has not been done with this firmware; every item above comes from the schematic.
```

## boards/mimxrt1180_evk/board.yml
```yaml
board: mimxrt1180_evk
mcu: MIMXRT1189
cores: [m33, m7]
external_memory:
  qspi_nor:
    family: Winbond W25Q128JWSIQ
    board_population: Two devices (U10 and U12), each 128 Mbit, on FlexSPI1 A/B paths
    selected_layout_scope: One 128-Mbit device / one 16-MiB address space
    expected_capacity_bytes: 16777216
    page_size_bytes: 256
    sector_erase_bytes: 4096
    block_erase_bytes: [32768, 65536]
    verification: pending_on_physical_board
  hyperram:
    present: true
notes:
  - Confirm board revision and exact fitted NOR ordering code before programming.
  - Board support must own pinmux, clocks, FlexSPI LUT, boot straps and memory map.
```
